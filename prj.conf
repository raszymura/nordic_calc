## CMakeLists.txt
```
cmake_minimum_required(VERSION 3.20.0)
find_package(Zephyr REQUIRED HINTS $ENV{ZEPHYR_BASE})

project(NONE)

# NORDIC SDK APP START
target_sources(app PRIVATE
  src/main.c
  src/my_cds.c
)
# NORDIC SDK APP END

zephyr_library_include_directories(.)
```

## prj.conf
```kconfig
# Logger module
CONFIG_LOG=y

# Button and LED library
CONFIG_DK_LIBRARY=y

# Bluetooth LE
CONFIG_BT=y

# Peripheral Role support
CONFIG_BT_PERIPHERAL=y

# Bluetooth LE device name
CONFIG_BT_DEVICE_NAME="Nordic_Calculator" # Nordic_Peripheral

# Enable the floating point unit
CONFIG_FPU=y
CONFIG_FPU_SHARING=y  # float operations across multiple threads

# Increase stack size for the main thread and System Workqueue
CONFIG_SYSTEM_WORKQUEUE_STACK_SIZE=2048
CONFIG_MAIN_STACK_SIZE=2048
```

## src/main.c
```c
/*
 * Rafal Szymura
 * June 2024
 */

/*
 * Two custom characteristics for the service handling, binary data exchange:
 * (1) Write: For sending data (arguments and operations) to the board 
 * (2) Notify: For receiving data (result of the operation) from the board
 */

/** @file
 *  @brief Nordic BLE Calculator Application
 */
#include <zephyr/kernel.h>
#include <zephyr/logging/log.h>
#include <zephyr/bluetooth/bluetooth.h> // Header file of the Bluetooth LE stack
#include <zephyr/bluetooth/gap.h>       // Header file of the Bluetooth LE stack
#include <zephyr/bluetooth/uuid.h>  	// Header file of the UUID helper macros and definitions
#include <zephyr/bluetooth/conn.h>  	// Header file for managing Bluetooth LE Connections
#include <dk_buttons_and_leds.h>    	// Header file for buttons and LEDs on a Nordic devkit
#include "my_cds.h"    					// Header file of custom Calculator Data Service

static struct bt_le_adv_param *adv_param = BT_LE_ADV_PARAM(
	(BT_LE_ADV_OPT_CONNECTABLE |
	BT_LE_ADV_OPT_USE_IDENTITY), // Connectable advertising and use identity address
	800, // Min Advertising Interval 500ms (800*0.625ms)
	801, // Max Advertising Interval 500.625ms (801*0.625ms)
	NULL); // Set to NULL for undirected advertising

LOG_MODULE_REGISTER(BLE_Calculator_App, LOG_LEVEL_INF);

// Semaphor ----------------------------------------------------------------------------------------
K_SEM_DEFINE(result_sem, 0, 1);
extern struct k_sem result_sem;
// Message queue -----------------------------------------------------------------------------------
#define CALC_MSGQ_MAX_MSGS 10
#define CALC_MSGQ_MSG_SIZE sizeof(struct calculator_task)
K_MSGQ_DEFINE(calculator_msgq, CALC_MSGQ_MSG_SIZE, CALC_MSGQ_MAX_MSGS, 4);
extern struct k_msgq calculator_msgq;
// -------------------------------------------------------------------------------------------------

#define DEVICE_NAME CONFIG_BT_DEVICE_NAME
#define DEVICE_NAME_LEN (sizeof(DEVICE_NAME) - 1)

#define RUN_STATUS_LED DK_LED1
#define CON_STATUS_LED DK_LED2
#define USER_LED DK_LED3

#define STACKSIZE 1024
#define SEND_DATA_PRIORITY 7
#define CALCULATOR_ENGINE_PRIORITY 7

#define RUN_LED_BLINK_INTERVAL 1000

//  Manufacturer Specific Data (Additional advertisement data) -------------------------------------
#define COMPANY_ID_CODE 0x0059  // Company identifier (Company ID)
// Declare the structure for custom data
typedef struct adv_mfg_data {
	uint16_t company_code;  		// Company Identifier Code
	uint16_t seconds_since_reset;	// Number of seconds since reset
} adv_mfg_data_type;
// Define and initialize a variable of type adv_mfg_data_type
static adv_mfg_data_type adv_mfg_data = { COMPANY_ID_CODE, 0x00 };
// -------------------------------------------------------------------------------------------------

static ReturnValue app_result_value;  // Data to notify over BLE

// Create the advertising parameter for connectable advertising ------------------------------------
static const struct bt_data ad[] = {
	// Set the flags and populate the device name in the advertising packet
	BT_DATA_BYTES(BT_DATA_FLAGS, (BT_LE_AD_GENERAL | BT_LE_AD_NO_BREDR)),
	BT_DATA(BT_DATA_NAME_COMPLETE, DEVICE_NAME, DEVICE_NAME_LEN),
	// Manufacturer Specific Data in the advertising packet
	BT_DATA(BT_DATA_MANUFACTURER_DATA, (unsigned char *)&adv_mfg_data, sizeof(adv_mfg_data)),
};

static const struct bt_data sd[] = {
	// Include the 16-bytes (128-Bits) UUID of the CDS service in the scan response packet
	BT_DATA_BYTES(BT_DATA_UUID128_ALL, BT_UUID_CDS_VAL),
};
// -------------------------------------------------------------------------------------------------


// ----------- Callback functions ------------------------------------------------------------------
static void app_mode_cb(bool mode_state) // Mode (float or fixed) LED indicator
{
	dk_set_led(USER_LED, mode_state);
}

static struct my_cds_cb app_callbacks = {
	.mode_cb = app_mode_cb,
};
// ----------- END: Callback functions -------------------------------------------------------------


// ----------- Connection Callback functions -------------------------------------------------------
static void on_connected(struct bt_conn *conn, uint8_t err)
{
	if (err) {
		printk("Connection failed (err %u)\n", err);
		return;
	}
	printk("** Connected! **\n");
	dk_set_led_on(CON_STATUS_LED);  // Turn the connection status LED on
}

static void on_disconnected(struct bt_conn *conn, uint8_t reason)
{
	printk("** Disconnected (reason %u) **\n", reason);
	dk_set_led_off(CON_STATUS_LED);  // Turn the connection status LED off
}

struct bt_conn_cb connection_callbacks = {
	.connected = on_connected,
	.disconnected = on_disconnected,
};
// ----------- END: Connection Callback functions --------------------------------------------------


// ----------- Thread functions --------------------------------------------------------------------
void send_data_thread(void)
{
    while (1) {
        k_sem_take(&result_sem, K_FOREVER);  // Wait for the semaphore

        int err = my_cds_send_result_notify(app_result_value);
		if (err) {
			LOG_ERR("Failed to send notification (err %d)\n", err);
		}
    }
}

void calculator_engine_thread(void)
{
    struct calculator_task task;

    while (1) {
        // Wait indefinitely for data
        k_msgq_get(&calculator_msgq, &task, K_FOREVER);  // Get the task from the message queue
        app_result_value = my_cds_calculate_result(task);// Perform calculations based on the task
        k_sem_give(&result_sem);  // Set semaphore to notify the send_data_thread that the result is ready
    }
}
// ----------- END: Thread functions ---------------------------------------------------------------



// -------------------------------------------------------------------------------------------------
int main(void)
{
	int blink_status = 0;
	int err;

	LOG_INF("Starting Nordic Calculator\n");

	err = dk_leds_init();
	if (err) {
		LOG_ERR("LEDs init failed (err %d)\n", err);
		return -1;
	}

	err = bt_enable(NULL);
	if (err) {
		LOG_ERR("Bluetooth init failed (err %d)\n", err);
		return -1;
	}
	bt_conn_cb_register(&connection_callbacks);  // Register connection callbacks
	// Pass application callback functions stored in app_callbacks to the Calculator Service
	err = my_cds_init(&app_callbacks);
	if (err) {
		printk("Failed to init CDS (err:%d)\n", err);
		return -1;
	}
	
	LOG_INF("Bluetooth initialized\n");

	err = bt_le_adv_start(adv_param, ad, ARRAY_SIZE(ad), sd, ARRAY_SIZE(sd));
	if (err) {
		LOG_ERR("Advertising failed to start (err %d)\n", err);
		return -1;
	}
	LOG_INF("Advertising successfully started\n");

	while (1) {
		// Update the advertising data dynamically
		adv_mfg_data.seconds_since_reset = k_uptime_get() / 1000;  // Update number of seconds since reset
		bt_le_adv_update_data(ad, ARRAY_SIZE(ad), sd, ARRAY_SIZE(sd));  // Update adv

		dk_set_led(RUN_STATUS_LED, (++blink_status) % 2);
		k_sleep(K_MSEC(RUN_LED_BLINK_INTERVAL));
	}
}
// ------- END: int main(void) ---------------------------------------------------------------------


// ------- THREADS ---------------------------------------------------------------------------------
// Define and initialize the 'Send Data' thread
K_THREAD_DEFINE(send_data_thread_id, STACKSIZE, send_data_thread, NULL, NULL,
					NULL, SEND_DATA_PRIORITY, 0, 0);

// Define and initialize the 'Calculator Engine' thread
K_THREAD_DEFINE(calculator_engine_thread_id, STACKSIZE, calculator_engine_thread, NULL, NULL,
                	NULL, CALCULATOR_ENGINE_PRIORITY, 0, 0);
// -------END: THREADS -----------------------------------------------------------------------------
```

## src/my_cds.c
```c
/*
 * Rafal Szymura
 * June 2024
 * BLE Calculator Application
 */

/** @file
 *  @brief Calculator Data Service (CDS)
 */

#include <zephyr/types.h>
#include <stddef.h>
#include <string.h>
#include <errno.h>
#include <zephyr/sys/printk.h>
#include <zephyr/sys/byteorder.h>
#include <zephyr/kernel.h>
#include <zephyr/logging/log.h>
#include <zephyr/bluetooth/bluetooth.h>
#include <zephyr/bluetooth/hci.h>
#include <zephyr/bluetooth/conn.h>
#include <zephyr/bluetooth/uuid.h>
#include <zephyr/bluetooth/gatt.h>  // GATT (Generic Attribute Profile) header
#include "my_cds.h"

LOG_MODULE_DECLARE(BLE_Calculator_App);

// -------------------------------------------------------------------------------------------------
static bool notify_result_enabled;
static struct my_cds_cb  cds_cb;
// -------------------------------------------------------------------------------------------------
extern struct k_sem result_sem;  // Semaphor
extern struct k_msgq calculator_msgq;  // Message queue
// -------------------------------------------------------------------------------------------------

// Define the configuration change callback function for the result characteristic
static void mycdsbc_ccc_result_cfg_changed(const struct bt_gatt_attr *attr, uint16_t value)
{
	notify_result_enabled = (value == BT_GATT_CCC_NOTIFY);  // Check if notifications are enabled
}

static ssize_t write_operation(struct bt_conn *conn, const struct bt_gatt_attr *attr, const void *buf,
			 uint16_t len, uint16_t offset, uint8_t flags)
{	
    LOG_DBG("Attribute write, handle: %u, conn: %p", attr->handle, (void *)conn);

	if (len != sizeof(struct calculator_task)) { 
		LOG_DBG("Write operation: Incorrect data length");
		return BT_GATT_ERR(BT_ATT_ERR_INVALID_ATTRIBUTE_LEN);
	}

	if (offset != 0) {
		LOG_DBG("Write operation: Incorrect data offset");
		return BT_GATT_ERR(BT_ATT_ERR_INVALID_OFFSET);
	}
	// Cast the buffer to the calculator_task struct
    struct calculator_task *task = (struct calculator_task *)buf;  // Read the received value

	// Unused
	// struct calculator_task *task;
    // memcpy(task, buf, sizeof(task));  // Copy the received data into the task variable

/*	// Display the contents of the struct
	printk("Operation: %u\n", task->operation);
	if (task->mode) {
		printk("Float Operand 1: %f\n", task.f_operand_1);
		printk("Float Operand 2: %f\n", task.f_operand_2);
	} else {
		printk("Float Operand: %f\n", task->f_operand);
	}
	printk("Mode: %u\n", task->mode);
	printk("----------------\n");
*/
    k_msgq_put(&calculator_msgq, task, K_NO_WAIT);  // Put the task into the message queue

	// LED mode indicator: LED on: FIXED_MODE, LED off: FLOAT_MODE
	if (cds_cb.mode_cb) {
		if (task->mode == FLOAT_MODE || task->mode == FIXED_MODE) {
			// Call the application callback function to update the mode state
			cds_cb.mode_cb(task->mode ? true : false);  // LED on when FIXED_MODE
		} else {
			LOG_DBG("Write mode: Incorrect value");
			return BT_GATT_ERR(BT_ATT_ERR_VALUE_NOT_ALLOWED);
		}
	}

	return len;  // Return the length of the received data
}

// GATT Calculator Data Service (CDS) Declaration --------------------------------------------------
BT_GATT_SERVICE_DEFINE(  // Statically add the service to the attributes table of our board (the GATT server) 
	my_cds_svc, BT_GATT_PRIMARY_SERVICE(BT_UUID_CDS),  // Primary service with a custom UUID
	BT_GATT_CHARACTERISTIC(BT_UUID_CDS_OPERATION, BT_GATT_CHRC_WRITE,
				BT_GATT_PERM_WRITE, NULL, write_operation, NULL), // Writing operations Characteristic
	BT_GATT_CHARACTERISTIC(BT_UUID_CDS_RESULT, BT_GATT_CHRC_NOTIFY,
				BT_GATT_PERM_NONE, NULL, NULL, NULL),  // Notify result Characteristic
	BT_GATT_CCC(mycdsbc_ccc_result_cfg_changed, BT_GATT_PERM_READ | BT_GATT_PERM_WRITE),
);

// Register application callbacks for the CDS characteristics --------------------------------------
int my_cds_init(struct my_cds_cb *callbacks)
{
	if (callbacks) {
		cds_cb.mode_cb = callbacks->mode_cb;
	}

	return 0;
}


// Thread functions --------------------------------------------------------------------------------
// Function to send notifications for the result characteristic (send_data_thread) -----------------
int my_cds_send_result_notify(ReturnValue result_value)
{
	if (!notify_result_enabled) {
		return -EACCES;
	}
	printk("...notifying...");
	if (result_value.type == FLOAT_TYPE) {
		float result_f = result_value.value.f;
		printk("Result = %f\n\n", result_value.value.f);
		return bt_gatt_notify(NULL, &my_cds_svc.attrs[4], &result_f, sizeof(result_f));
	} else if (result_value.type == INT32_TYPE) {
		int32_t result_u = result_value.value.u;
		printk("Result = %d\n\n", result_value.value.u);
		return bt_gatt_notify(NULL, &my_cds_svc.attrs[4], &result_u, sizeof(result_u));
	}
	return -1;
}
// -------------------------------------------------------------------------------------------------

// Function to calculate the equation result (calculator_engine_thread) ----------------------------
ReturnValue my_cds_calculate_result(struct calculator_task task)
{  
	/* // Display the contents of the struct
    printk("Operation in calculator thread: %u\n", task.operation);
	if (task.mode == FLOAT_MODE) {
		printk("Float Operand 1: %d\n", (int32_t)task.f_operand_1);
		printk("Float Operand 2: %d\n", (int32_t)task.f_operand_2);
		printk("FLOAT_MODE\n");
    } else { // FIXED_MODE
		printk("Q31 Operand 1: %d\n", task.q31_operand_1);
		printk("Q31 Operand 2: %d\n", task.q31_operand_2);
		printk("FIXED_MODE\n");
	}
	printk("----------------\n");
	*/

	float result_f = 0.0f;	// Initialize the floating-point result to 0
	int32_t result_q31 = 0;	// Initialize the fixed-point result to 0

	ReturnValue result;

	if (task.mode == FLOAT_MODE) { 
		switch (task.operation) {
			case 0: // Reset
				result_f = 0.0f;
				break;
			case 1: // Add
				result_f = task.f_operand_1 + task.f_operand_2;
				break;
			case 2: // Subtract
				result_f = task.f_operand_1 - task.f_operand_2;
				break;
			case 3: // Multiply
				result_f = task.f_operand_1 * task.f_operand_2;
				break;
			case 4: // Divide
				if (task.f_operand_2 > EPSILON || task.f_operand_2 < -EPSILON) { // Division by zero, also checked in TEST TOOL python app
					result_f = task.f_operand_1 / task.f_operand_2;
				} else {
					printk("Error: Division by zero.");
					result_f = 0.0f;
				}
				break;
			default:
				break;
			/*
			 if (isinf(result_f) || isnan(result_f)){
				printk("Float Overflow!");
			result_q31 = 0.0f;
			 }
			*/
		}
	} else { // FIXED_MODE - https://en.wikipedia.org/wiki/Q_(number_format)
		switch (task.operation) {
			case 0: // Reset
				result_q31 = 0;
				break;
			case 1: // Add
				result_q31 = task.q31_operand_1 + task.q31_operand_2;
				if (((task.q31_operand_2 > 0) && (task.q31_operand_1 > INT_MAX - task.q31_operand_2)) ||
					((task.q31_operand_2 < 0) && (task.q31_operand_1 < INT_MIN - task.q31_operand_2))) {
					printk("Integer Overflow in addition!");
					result_q31 = 0;
				}
				break;
			case 2: // Subtract
				result_q31 = task.q31_operand_1 - task.q31_operand_2;
				if (((task.q31_operand_2 > 0) && (task.q31_operand_1 < INT_MIN + task.q31_operand_2)) ||
					((task.q31_operand_2 < 0) && (task.q31_operand_1 > INT_MAX + task.q31_operand_2))) {
					printk("Integer Overflow in subtraction!");
					result_q31 = 0;
				}
				break;
			case 3: // Multiply
				int64_t result_q62 = (int64_t)task.q31_operand_1 * (int64_t)task.q31_operand_2;  // Convert 'q31_operand' to Q62 format (prevent overflow)
				result_q62 = (result_q62 >> 31);

				if ((result_q62 > INT32_MAX) || (result_q62 < INT32_MIN)) {
					printk("Integer Overflow in multiplication!");
				 	result_q62 = 0;
				}
				result_q31 = (int32_t )result_q62;  // Convert result back to Q31 format
				break;
			case 4: // Divide
				if (task.q31_operand_2 > EPSILON || task.q31_operand_2 < -EPSILON) {  // Division by zero, also checked in TEST TOOL python app
					result_q31 = q_div(task.q31_operand_1, task.q31_operand_2);
				} else {
					printk("Error: Division by zero.");
					result_q62 = 0;
				}
				break;
			default:
				break;
		}
	}

    // Notify result
    if (task.mode == FLOAT_MODE) {
		result.value.f = result_f;
		result.type = FLOAT_TYPE;
    } else { // FIXED_MODE
		result.value.u = result_q31;
		result.type = INT32_TYPE;
    }

	return result;
}
// -------------------------------------------------------------------------------------------------

int32_t q_div(int32_t a, int32_t b)
{
    int64_t temp = (int64_t)a << 31;
    if ((temp >= 0 && b >= 0) || (temp < 0 && b < 0)) {   
        temp += b / 2;
    } else {
        temp -= b / 2;
    }
	temp = (temp / b);
	if ((temp > INT32_MAX) || (temp < INT32_MIN)) {
		printk("Integer Overflow in division!");
		temp = 0;
	}
    return (int32_t)temp;
}
```

## src/my_cds.h
```c
/*
 * Rafal Szymura
 * June 2024
 * BLE Calculator Application
 */

#ifndef BT_CDS_H_
#define BT_CDS_H_

/**@file
 * @defgroup bt_cds Calculator Data Service (CDS) API
 * @{
 * @brief API for the Calculator Data Service (CDS).
 */

#ifdef __cplusplus
extern "C" {
#endif

#include <zephyr/types.h>

// MODES:
#define FLOAT_MODE 0  // 32-bit floating-point mode
#define FIXED_MODE 1  // Q31 fixed-point mode
// -------------------------------------------------------------------------------------------------
#pragma pack(push, 1) // Preserve current packing settings and set packing to 1 byte
struct calculator_task {		// Define a structure for calculator tasks
	uint8_t operation;			// Operation to be performed (e.g., add, subtract)
	union {						// Union for 1 argument, allowing either float or fixed-point integer.
		float f_operand_1;		// 32-bit floating-point operand
        int32_t q31_operand_1;	// Fixed-point (Q31) operand
	};
	union {						// Union for 2 argument, allowing either float or fixed-point integer.
		float f_operand_2;		// 32-bit floating-point operand
		int32_t q31_operand_2;	// Fixed-point (Q31) operand
	};
	bool mode;					// Mode: floating-point (0) or fixed-point (1)
};
#pragma pack(pop) // Restore original packing
// -------------------------------------------------------------------------------------------------
typedef union {
    int32_t u;
    float f;
} int32_float_union;

typedef enum {
    INT32_TYPE,
    FLOAT_TYPE
} ReturnType;

typedef struct {
    int32_float_union value;
    ReturnType type;
} ReturnValue;
// -------------------------------------------------------------------------------------------------

#define EPSILON 1e-10  // Division by zero

// -------------------------------------------------------------------------------------------------
// UUID generated with: https://www.uuidgenerator.net/
/** @brief CDS Service UUID. */
#define BT_UUID_CDS_VAL BT_UUID_128_ENCODE(0x6e7e652f,0x0b5d,0x4de6,0xbcd9,0xa071d34c3e9f)

/** @brief Arguments and operations Characteristic UUID. */
#define BT_UUID_CDS_OPERATION_VAL BT_UUID_128_ENCODE(0x448e4b02,0xb99a,0x4f57,0xa76d,0xd283933c2fd5)

/** @brief Calculated equation result Characteristic UUID. */
#define BT_UUID_CDS_RESULT_VAL BT_UUID_128_ENCODE(0x4d19fe91,0x2164,0x49a8,0x9022,0x55ba662ce6fc)

// Convert the array to a generic UUID
#define BT_UUID_CDS 			BT_UUID_DECLARE_128(BT_UUID_CDS_VAL)
#define BT_UUID_CDS_OPERATION	BT_UUID_DECLARE_128(BT_UUID_CDS_OPERATION_VAL)
#define BT_UUID_CDS_RESULT 		BT_UUID_DECLARE_128(BT_UUID_CDS_RESULT_VAL)


/** @brief Callback type for when a operation is received. */
typedef void (*mode_cb_t)(const bool mode_state); // Mode (float or fixed) LED indicator


/** @brief Callback struct used by the CDS Service. */
struct my_cds_cb {
	mode_cb_t mode_cb;  // LED state change callback
};
// -------------------------------------------------------------------------------------------------

/** @brief Initialize the CDS Service.
 *
 * This function registers application callback functions with the My CDS Service
 *
 * @param[in] callbacks Struct containing pointers to callback functions
 *			used by the service. This pointer can be NULL
 *			if no callback functions are defined.
 *
 * @retval 0 If the operation was successful.
 *           Otherwise, a (negative) error code is returned.
 */
int my_cds_init(struct my_cds_cb *callbacks);

/** @brief Send the result value as notification.
 *
 * This function sends an int32_t or float equation result value. 
 *
 * @param[in] result_value The equation result value.
 *
 * @retval 0 If the operation was successful. Otherwise, a (negative) error code is returned.
 */
int my_cds_send_result_notify(ReturnValue result_value);

/** @brief Calculate the result value.
 *
 * This function calculates an int32_t or float equation result value. 
 *
 * @param[in] task The equation struct.
 *
 * @retval 0 If the operation was successful. Otherwise, a (negative) error code is returned.
 */
ReturnValue my_cds_calculate_result(struct calculator_task task);

/** @brief Calculate the result of q31 division.
 *
 * This function calculates an int32_t division result value. 
 *
 * @param[in] a dividend
* @param[in] b divider
 *
 * @retval int32_t result value.
 */
int32_t q_div(int32_t a, int32_t b);

#ifdef __cplusplus
}
#endif

/**
 * @}
 */

#endif /* BT_CDS_H_ */
```
